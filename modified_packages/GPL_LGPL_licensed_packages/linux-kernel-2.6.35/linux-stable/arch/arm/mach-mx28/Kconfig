## modified_packages/GPL_LGPL_licensed_packages/linux-kernel-2.6.35/linux-stable/arch/arm/mach-mx28/Kconfig
```kconfig
choice
	prompt "Select i.MXS board type"

config MACH_MX28EVK
	bool "Freescale MX28 EVK board"
	depends on ARCH_MX28
	select USB_ARCH_HAS_EHCI

endchoice

config MXS_UNIQUE_ID
        bool "Support for UniqueID on boot media"
        default y

config MXS_UNIQUE_ID_OTP
        bool "UniqueID on OTP"
        depends on MXS_UNIQUE_ID
        default y

config VECTORS_PHY_ADDR
	int "vectors address"
	default 0
	help
	  This config set vectors table is located which physical address

config MXS_TIMER_WITH_MACH
	bool "System Timer support Compare Match interrupt"
	default y

config MEM_mDDR
	bool "Memory type is mDDR"
	depends on ARCH_MX28
	help
	  Say Y to select mDDR memory

config WORKAROUND_ARCUSB_REG_RW
        bool "work around mx28 arch register write for USB"
        help
           MX28 require read ARC register before write. Use SWP intructure to
           implement this requirement.
```

## modified_packages/GPL_LGPL_licensed_packages/linux-kernel-2.6.35/linux-stable/drivers/net/wireless/marvell/w8782/Kconfig
```kconfig
config W8782
	tristate "Marvell 8782 USB WiFi"
	depends on USB
	select WIRELESS_EXT
	select WEXT_PRIV
	select WEXT_SPY
	select PANASONIC
	---help---
	  Help message of W8782
	  Selects WIRELESS_EXT, WEXT_PRIV and WEXT_SPY
	  

#13.11.2013/HG:
config PANASONIC
	tristate
	depends on W87882
	default m
	
```

## modified_packages/GPL_LGPL_licensed_packages/linux-kernel-2.6.35/linux-stable/drivers/net/wireless/wi2wi/w8786u/Kconfig
```kconfig
config W8786U
	tristate "Marvell 8786u USB WiFi"
	depends on USB
	select WIRELESS_EXT
	select WEXT_PRIV
	select WEXT_SPY
	select WI2WI
	---help---
	  Help message of W8786U
	  Selects WIRELESS_EXT, WEXT_PRIV and WEXT_SPY
	  

#13.11.2013/HG:
config WI2WI
	tristate
	depends on W8786U
	default m
	
```

## modified_packages/GPL_LGPL_licensed_packages/linux-kernel-2.6.35/linux-stable/drivers/video/mxs/Kconfig
```kconfig
config FB_MXS
	tristate "MXS Framebuffer driver"
	depends on FB && ARCH_MXS
	select FB_CFB_FILLRECT
	select FB_CFB_COPYAREA
	select FB_CFB_IMAGEBLIT
	default y
	---help---
	  Say Y here to enable support for the framebuffer driver for the
	  Freescale MXS Board.

#config FB_MXS_LCD_43WVF1G
#	depends on FB_MXS
#	tristate "SEIKO 4.3' LCD WVGA(800x480) PANEL"
#	default y if ARCH_MX28

config FB_MXS_LCD_LMS430
	depends on FB_MXS
	bool "LMS430"
	default y if ARCH_MX28
	---help---
	  Use LMS430 dotclock LCD panel for MXS

config FB_MXS_LCD_LMS430_URT
	bool "URT display timings"
	depends on FB_MXS_LCD_LMS430
	default y if FB_MXS_LCD_LMS430
	help
	  Say Y here if you would like to use the display timings for 
	  the URT LCD. Otherwise, Ampire the old display timings will be
	  used. Ampire display yet also works with this setting, so
	  it should be safe to say Y.

config FB_MXS_TVENC
	depends on ARCH_MXS
	bool "TVENC"
	---help---
	  Use TVOUT encoder for MXS
```
